## subsys/ctr_button/Kconfig
```kconfig
#
# Copyright (c) 2023 HARDWARIO a.s.
#
# SPDX-License-Identifier: LicenseRef-HARDWARIO-5-Clause
#

config CTR_BUTTON
	bool "CTR_BUTTON"
	select GPIO
	select CTR_EDGE

if CTR_BUTTON

module = CTR_BUTTON
module-str = CHESTER Button Subsystem
source "subsys/logging/Kconfig.template.log_config"

config CTR_BUTTON_INIT_PRIORITY
	int "Initialization priority"
	default APPLICATION_INIT_PRIORITY

config CTR_BUTTON_SHELL
	bool
	default y
	depends on SHELL

config CTR_BUTTON_DWELL_MS
	int "Level dwell required to accept a transition [ms]"
	default 50
	help
	  How long a button line must hold its new level, uninterrupted, before
	  the transition is accepted. Must be greater than
	  CTR_BUTTON_COOLDOWN_MS, otherwise the interrupt is never re-armed in
	  time to cancel a line that does not stay put and the debounce
	  degenerates into a race. A human press lasts 80-300 ms; LTE-induced
	  interference on the button nets follows the transmit envelope and
	  rarely holds this long.

config CTR_BUTTON_COOLDOWN_MS
	int "Interrupt re-arm delay [ms]"
	default 10
	help
	  How long after an edge the level interrupt is re-armed. The span
	  between this and CTR_BUTTON_DWELL_MS is the window in which a
	  wandering line gets its pending transition cancelled.

config CTR_BUTTON_MAX_PLAUSIBLE_CLICKS
	int "Reject click runs of this length or longer"
	default 5
	help
	  Measured phantom click runs are bimodal - 1, or a runaway 14-32, with
	  nothing in between - so a run this long is interference by
	  construction. No hand produces it inside the 600 ms sliding window.

config CTR_BUTTON_COINCIDENCE_MS
	int "Cross-channel coincidence window [ms]"
	default 100
	help
	  If both button channels see an edge within this window, both runs are
	  discarded: a hand cannot press the on-board and the external button
	  simultaneously, but interference reaches both through the adjacent
	  module pins. Set to 0 to disable the rule.

endif # CTR_BUTTON
```

## subsys/ctr_cloud/Kconfig
```kconfig
#
# Copyright (c) 2023 HARDWARIO a.s.
#
# SPDX-License-Identifier: LicenseRef-HARDWARIO-5-Clause
#

config CTR_CLOUD
	bool "CTR_CLOUD"
	depends on SHIELD_CTR_LTE_V2 || NET_L2_ETHERNET
	select CTR_BUF
	select CTR_INFO
	select CTR_RTC
	select EVENTS
	select TINYCRYPT_SHA256
	select TINYCRYPT
	select ZCBOR
	select ZCBOR_STOP_ON_ERROR
	select SHELL
	select SHELL_BACKEND_DUMMY
	select BASE64

if CTR_CLOUD

module = CTR_CLOUD
module-str = CHESTER CLOUD Subsystem
source "subsys/logging/Kconfig.template.log_config"

config SHELL_BACKEND_DUMMY_BUF_SIZE
	int "SHELL_BACKEND_DUMMY_BUF_SIZE"
	default 8192

config CTR_CLOUD_TRANSFER_BUF_SIZE
	int "Cloud transfer buffer size in bytes"
	default 16384
	help
	  Staging buffer for one cloud message before fragmentation. 16 KiB is
	  the historical default. A wired node can run much smaller; 8 KiB was
	  used on the BET-199 Ethernet PoC.

choice CTR_CLOUD_TRANSPORT
	prompt "Cloud transport"
	default CTR_CLOUD_TRANSPORT_LTE if SHIELD_CTR_LTE_V2
	default CTR_CLOUD_TRANSPORT_SOCKET

config CTR_CLOUD_TRANSPORT_LTE
	bool "Cellular (ctr_lte_v2)"
	depends on SHIELD_CTR_LTE_V2

config CTR_CLOUD_TRANSPORT_SOCKET
	bool "IP socket"
	depends on NETWORKING
	select NET_SOCKETS
	select NET_UDP
	select DNS_RESOLVER
	# SO_RCVTIMEO is compiled out without this; the transport would then
	# block forever on recv instead of timing out. Not optional.
	select NET_CONTEXT_RCVTIMEO

endchoice

if CTR_CLOUD_TRANSPORT_SOCKET

config CTR_CLOUD_SOCKET_HOST
	string "HARDWARIO Cloud host"
	default "157.245.24.13"
	help
	  Hostname or dotted-quad address of the cloud ingress. The default is
	  the public ingress, used when the device is not on a private APN.

config CTR_CLOUD_SOCKET_PORT
	int "HARDWARIO Cloud UDP port"
	default 5003

endif # CTR_CLOUD_TRANSPORT_SOCKET

endif # CTR_CLOUD
```

## tests/subsys/ctr_button/testcase.yaml
```yaml
common:
  tags:
      - chester
  platform_allow:
    - native_posix
    - qemu_cortex_m3
  integration_platforms:
    - native_posix

tests:
  subsys.ctr_button.policy: {}
```
